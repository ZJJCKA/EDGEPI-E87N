// SPDX-License-Identifier: (GPL-2.0 OR MIT)
/*
 * Copyright (C) 2023 MediaTek Inc.
 * Author: Frank Wunderlich <frank-w@public-files.de>
 */

/dts-v1/;
/plugin/;

#include <dt-bindings/gpio/gpio.h>

/ {
	compatible = "mediatek,mt7988a-rfb", "mediatek,mt7988a";

	fragment@0 {
		target-path = <&mmc0>;
		__overlay__ {
			#address-cells = <1>;
			#size-cells = <0>;
			pinctrl-names = "default", "state_uhs";
			pinctrl-0 = <&mmc0_pins_sdcard>;
			pinctrl-1 = <&mmc0_pins_sdcard>;
			cd-gpios = <&pio 69 GPIO_ACTIVE_LOW>;
			bus-width = <4>;
			max-frequency = <52000000>;
			cap-sd-highspeed;
			vmmc-supply = <&reg_3p3v>;
			vqmmc-supply = <&reg_3p3v>;
			no-mmc;
			status = "okay";

			card@0 {
				compatible = "mmc-card";
				reg = <0>;

				partitions {
					compatible = "gpt-partitions";

					block-partition-env {
						partname = "ubootenv";
						nvmem-layout {
							compatible = "u-boot,env-layout";
						};
					};

					sd_root: block-partition-production {
						partname = "production";
					};
				};
			};
		};
	};

	fragment@1 {
		target-path = "/chosen";
		__overlay__ {
			rootdisk-sd = <&sd_root>;
		};
	};
};
